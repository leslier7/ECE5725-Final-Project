## sample.yaml
```
sample:
  name: ESB prx Sample
tests:
  sample.esb.prx.dongle:
    sysbuild: true
    build_only: true
    integration_platforms:
      - nrf52840dongle/nrf52840
    platform_allow:
      - nrf52840dongle/nrf52840
    extra_configs:
      - CONFIG_UART_CONSOLE=y
      - CONFIG_SERIAL_SUPPORT_INTERRUPT=y
    extra_args: BOARD_VARIANT=dongle_specific
    tags:
      - esb
      - ci_build
      - dongle
  sample.esb.prx:
    sysbuild: true
    filter: CONFIG_UART_CONSOLE and CONFIG_SERIAL_SUPPORT_INTERRUPT
    harness: keyboard
    integration_platforms:
      - nrf52840dk/nrf52840
      - nrf52840dongle/nrf52840
    platform_allow:
      - nrf52840dk/nrf52840
      - nrf52840dongle/nrf52840
    tags:
      - esb
      - samples
      - console
      - sysbuild
      - ci_samples_esb
  # sample.esb.prx.build:
  #   sysbuild: true
  #   build_only: true
  #   integration_platforms:
  #     - nrf52dk/nrf52832
  #     - nrf52833dk/nrf52833
  #     - nrf52840dk/nrf52840
  #     - nrf52dk/nrf52810
  #     - nrf5340dk/nrf5340/cpunet
  #     - nrf21540dk/nrf52840
  #     - nrf54h20dk/nrf54h20/cpurad
  #     - nrf54l15dk/nrf54l05/cpuapp
  #     - nrf54l15dk/nrf54l10/cpuapp
  #     - nrf54l15dk/nrf54l15/cpuapp
  #     - nrf54lm20dk/nrf54lm20a/cpuapp
  #   platform_allow:
  #     - nrf52dk/nrf52832
  #     - nrf52833dk/nrf52833
  #     - nrf52840dk/nrf52840
  #     - nrf52dk/nrf52810
  #     - nrf5340dk/nrf5340/cpunet
  #     - nrf21540dk/nrf52840
  #     - nrf54h20dk/nrf54h20/cpurad
  #     - nrf54l15dk/nrf54l05/cpuapp
  #     - nrf54l15dk/nrf54l10/cpuapp
  #     - nrf54l15dk/nrf54l15/cpuapp
  #     - nrf54lm20dk/nrf54lm20a/cpuapp
  #   tags:
  #     - esb
  #     - ci_build
  #     - sysbuild
  #     - ci_samples_esb
  # sample.esb.prx.dynamic_irq:
  #   sysbuild: true
  #   build_only: true
  #   extra_configs:
  #     - CONFIG_ESB_DYNAMIC_INTERRUPTS=y
  #     - CONFIG_DYNAMIC_INTERRUPTS=y
  #     - CONFIG_DYNAMIC_DIRECT_INTERRUPTS=y
  #     - CONFIG_MPSL_DYNAMIC_INTERRUPTS=y
  #   integration_platforms:
  #     - nrf5340dk/nrf5340/cpunet
  #     - nrf52840dk/nrf52840
  #     - nrf54l15dk/nrf54l15/cpuapp
  #     - nrf54h20dk/nrf54h20/cpurad
  #   platform_allow:
  #     - nrf5340dk/nrf5340/cpunet
  #     - nrf52840dk/nrf52840
  #     - nrf54l15dk/nrf54l15/cpuapp
  #     - nrf54h20dk/nrf54h20/cpurad
  #   tags:
  #     - esb
  #     - ci_build
  #     - sysbuild
  #     - ci_samples_esb
  # sample.esb.prx.nrf5340_nrf21540:
  #   sysbuild: true
  #   build_only: true
  #   extra_args: SHIELD=nrf21540ek
  #   integration_platforms:
  #     - nrf5340dk/nrf5340/cpunet
  #   platform_allow: nrf5340dk/nrf5340/cpunet
  #   tags:
  #     - esb
  #     - ci_build
  #     - sysbuild
  #     - ci_samples_esb
  # sample.esb.prx.fast_switching:
  #   sysbuild: true
  #   build_only: true
  #   extra_configs:
  #     - CONFIG_ESB_FAST_SWITCHING=y
  #     - CONFIG_ESB_FAST_CHANNEL_SWITCHING=y
  #   integration_platforms:
  #     - nrf54h20dk/nrf54h20/cpurad
  #   platform_allow: >
  #     nrf54h20dk/nrf54h20/cpurad
  #   tags:
  #     - esb
  #     - ci_build
  #     - sysbuild
  #     - ci_samples_esb
```

## prj.conf
```kconfig
#
# Copyright (c) 2019 Nordic Semiconductor ASA
#
# SPDX-License-Identifier: LicenseRef-Nordic-5-Clause
#
CONFIG_NCS_SAMPLES_DEFAULTS=y
CONFIG_ESB=y
CONFIG_DK_LIBRARY=y
CONFIG_CLOCK_CONTROL=y
CONFIG_ESB_MAX_PAYLOAD_LENGTH=192

CONFIG_USB_DEVICE_STACK=y
CONFIG_USB_CDC_ACM=y
CONFIG_SERIAL=y
CONFIG_CONSOLE=y
CONFIG_UART_CONSOLE=y
CONFIG_LOG=y
CONFIG_LOG_BACKEND_UART=y
CONFIG_STDOUT_CONSOLE=y
CONFIG_CBPRINTF_FP_SUPPORT=y
```

## src/main.c
```c
/*
 * Copyright (c) 2018 Nordic Semiconductor ASA
 *
 * Modified by Robbie Leslie
 * 
 * SPDX-License-Identifier: LicenseRef-Nordic-5-Clause
 */
#include <zephyr/device.h>
#include <zephyr/devicetree.h>
#include <zephyr/drivers/clock_control.h>
#include <zephyr/drivers/clock_control/nrf_clock_control.h>
#include <zephyr/drivers/gpio.h>
#include <zephyr/irq.h>
#include <zephyr/logging/log.h>
#include <nrf.h>
#include <esb.h>
#include <zephyr/kernel.h>
#include <zephyr/types.h>
#include <dk_buttons_and_leds.h>
#if defined(CONFIG_CLOCK_CONTROL_NRF2)
#include <hal/nrf_lrcconf.h>
#endif
#include <nrf_erratas.h>
#if NRF54L_ERRATA_20_PRESENT
#include <hal/nrf_power.h>
#endif /* NRF54L_ERRATA_20_PRESENT */
#if defined(NRF54LM20A_ENGA_XXAA)
#include <hal/nrf_clock.h>
#endif /* defined(NRF54LM20A_ENGA_XXAA) */

#include <math.h>
#include <stdint.h>
#include "imu.h"

LOG_MODULE_REGISTER(esb_prx, CONFIG_ESB_PRX_APP_LOG_LEVEL);

typedef struct {
    uint8_t pipe;
    uint8_t button;
    IMU_DataPacked imu;
} imu_frame_t;

K_MSGQ_DEFINE(imu_msgq, sizeof(imu_frame_t), 16, 4);


static struct esb_payload rx_payload;
static struct esb_payload tx_payload = ESB_CREATE_PAYLOAD(0,
	0x10, 0x11, 0x12, 0x13, 0x14, 0x15, 0x16, 0x17);

static void leds_update(uint8_t value)
{
	uint32_t leds_mask =
		(!(value % 8 > 0 && value % 8 <= 4) ? DK_LED1_MSK : 0) |
		(!(value % 8 > 1 && value % 8 <= 5) ? DK_LED2_MSK : 0) |
		(!(value % 8 > 2 && value % 8 <= 6) ? DK_LED3_MSK : 0) |
		(!(value % 8 > 3) ? DK_LED4_MSK : 0);

	dk_set_leds(leds_mask);
}

uint16_t crc16_ccitt(const uint8_t *data, size_t len)
{
    uint16_t crc = 0xFFFF;
    for (size_t i = 0; i < len; i++) {
        crc ^= (uint16_t)data[i] << 8;
        for (int j = 0; j < 8; j++) {
            if (crc & 0x8000)
                crc = (crc << 1) ^ 0x1021;
            else
                crc <<= 1;
        }
    }
    return crc;
}

void event_handler(struct esb_evt const *event)
{
	switch (event->evt_id) {
	case ESB_EVENT_TX_SUCCESS:
		LOG_DBG("TX SUCCESS EVENT");
		break;
	case ESB_EVENT_TX_FAILED:
		LOG_DBG("TX FAILED EVENT");
		break;
	case ESB_EVENT_RX_RECEIVED:
		if (esb_read_rx_payload(&rx_payload) == 0) {
			switch (rx_payload.pipe) {
				case 1:
					//LOG_INF("Received from Transmitter A (pipe 1, prefix 0xA1)");
					break;
				case 2:
					//LOG_INF("Received from Transmitter B (pipe 2, prefix 0xB1)");
					break;
				default:
					LOG_INF("Received from pipe %d", rx_payload.pipe);
			}
			if (rx_payload.length >= (int)(1 + sizeof(IMU_DataPacked))) {
                imu_frame_t frame;
                frame.pipe = rx_payload.pipe;
                frame.button = rx_payload.data[0];
				// if(frame.button != 0){
				// 	dk_set_leds(DK_LED1_MSK | DK_LED2_MSK | DK_LED3_MSK | DK_LED4_MSK);
				// } else {
				// 	dk_set_leds(0);
				// }
                memcpy(&frame.imu, &rx_payload.data[1], sizeof(IMU_DataPacked));
                (void)k_msgq_put(&imu_msgq, &frame, K_NO_WAIT);

                leds_update(rx_payload.data[1]);
            } else {
                LOG_WRN("Unexpected payload length %d (expected >= %zu)",
                        rx_payload.length, 1 + sizeof(IMU_DataPacked));
            }

				//leds_update(rx_payload.data[1]);
		} else {
			LOG_ERR("Error while reading rx packet");
		}
		break;
	}
}

#if defined(CONFIG_CLOCK_CONTROL_NRF)
int clocks_start(void)
{
	int err;
	int res;
	struct onoff_manager *clk_mgr;
	struct onoff_client clk_cli;

	clk_mgr = z_nrf_clock_control_get_onoff(CLOCK_CONTROL_NRF_SUBSYS_HF);
	if (!clk_mgr) {
		LOG_ERR("Unable to get the Clock manager");
		return -ENXIO;
	}

	sys_notify_init_spinwait(&clk_cli.notify);

	err = onoff_request(clk_mgr, &clk_cli);
	if (err < 0) {
		LOG_ERR("Clock request failed: %d", err);
		return err;
	}

	do {
		err = sys_notify_fetch_result(&clk_cli.notify, &res);
		if (!err && res) {
			LOG_ERR("Clock could not be started: %d", res);
			return res;
		}
	} while (err);

#if NRF54L_ERRATA_20_PRESENT
	if (nrf54l_errata_20()) {
		nrf_power_task_trigger(NRF_POWER, NRF_POWER_TASK_CONSTLAT);
	}
#endif /* NRF54L_ERRATA_20_PRESENT */

#if defined(NRF54LM20A_ENGA_XXAA)
	/* MLTPAN-39 */
	nrf_clock_task_trigger(NRF_CLOCK, NRF_CLOCK_TASK_PLLSTART);
#endif

	LOG_DBG("HF clock started");
	return 0;
}

#elif defined(CONFIG_CLOCK_CONTROL_NRF2)

int clocks_start(void)
{
	int err;
	int res;
	const struct device *radio_clk_dev =
		DEVICE_DT_GET_OR_NULL(DT_CLOCKS_CTLR(DT_NODELABEL(radio)));
	struct onoff_client radio_cli;

	/** Keep radio domain powered all the time to reduce latency. */
	nrf_lrcconf_poweron_force_set(NRF_LRCCONF010, NRF_LRCCONF_POWER_DOMAIN_1, true);

	sys_notify_init_spinwait(&radio_cli.notify);

	err = nrf_clock_control_request(radio_clk_dev, NULL, &radio_cli);

	do {
		err = sys_notify_fetch_result(&radio_cli.notify, &res);
		if (!err && res) {
			LOG_ERR("Clock could not be started: %d", res);
			return res;
		}
	} while (err == -EAGAIN);

	nrf_lrcconf_clock_always_run_force_set(NRF_LRCCONF000, 0, true);
	nrf_lrcconf_task_trigger(NRF_LRCCONF000, NRF_LRCCONF_TASK_CLKSTART_0);

	LOG_DBG("HF clock started");

	return 0;
}

#else
BUILD_ASSERT(false, "No Clock Control driver");
#endif /* defined(CONFIG_CLOCK_CONTROL_NRF2) */

int esb_initialize(void)
{
	int err;
	/* These are arbitrary default addresses. In end user products
	 * different addresses should be used for each set of devices.
	 */
	uint8_t base_addr_0[4] = {0xE7, 0xE7, 0xE7, 0xE7};
	uint8_t base_addr_1[4] = {0xC2, 0xC2, 0xC2, 0xC2};
	uint8_t addr_prefix[8] = {0xE7, 0xA1, 0xB1, 0xC4, 0xC5, 0xC6, 0xC7, 0xC8};

	struct esb_config config = ESB_DEFAULT_CONFIG;

	config.protocol = ESB_PROTOCOL_ESB_DPL;
	config.bitrate = ESB_BITRATE_2MBPS;
	config.mode = ESB_MODE_PRX;
	config.payload_length = 48;
	config.event_handler = event_handler;
	config.selective_auto_ack = true;
	if (IS_ENABLED(CONFIG_ESB_FAST_SWITCHING)) {
		config.use_fast_ramp_up = true;
	}

	err = esb_init(&config);
	if (err) {
		return err;
	}

	err = esb_set_base_address_0(base_addr_0);
	if (err) {
		return err;
	}

	err = esb_set_base_address_1(base_addr_1);
	if (err) {
		return err;
	}

	err = esb_set_prefixes(addr_prefix, ARRAY_SIZE(addr_prefix));
	if (err) {
		return err;
	}

	return 0;
}

int main(void)
{
	int err;

	LOG_INF("Enhanced ShockBurst prx sample");

	err = clocks_start();
	if (err) {
		return 0;
	}

	err = dk_leds_init();
	if (err) {
		LOG_ERR("LEDs initialization failed, err %d", err);
		//return 0;
	} else {
		LOG_DBG("LEDs initialized");
	}

	err = esb_initialize();
	if (err) {
		LOG_ERR("ESB initialization failed, err %d", err);
		return 0;
	}

	LOG_INF("Initialization complete");

	err = esb_write_payload(&tx_payload);
	if (err) {
		LOG_ERR("Write payload, err %d", err);
		return 0;
	}

	LOG_INF("Setting up for packet receiption");

	err = esb_start_rx();
	if (err) {
		LOG_ERR("RX setup failed, err %d", err);
		return 0;
	}

	imu_frame_t frame;
	static uint16_t seq = 0;

	while(1){
		k_msgq_get(&imu_msgq, &frame, K_FOREVER);

        // Build payload: pipe + button + seq + imu
        uint8_t payload[1 + 1 + 2 + sizeof(IMU_DataPacked)];
        size_t idx = 0;
        payload[idx++] = frame.pipe;
        payload[idx++] = frame.button;    /* include button */

        // seq as little-endian u16
        payload[idx++] = (uint8_t)(seq & 0xFF);
        payload[idx++] = (uint8_t)((seq >> 8) & 0xFF);

        memcpy(&payload[idx], &frame.imu, sizeof(IMU_DataPacked));
        idx += sizeof(IMU_DataPacked);

        // CRC over payload
        uint16_t crc = crc16_ccitt(payload, idx);

        // Now build final wire frame: header + payload + crc
        uint8_t msg[3 + sizeof(payload) + 2];
        size_t midx = 0;

        msg[midx++] = 0x77;
        msg[midx++] = 0x55;
        msg[midx++] = 0xAA;

        memcpy(&msg[midx], payload, idx);
        midx += idx;

        msg[midx++] = (uint8_t)(crc & 0xFF);
        msg[midx++] = (uint8_t)((crc >> 8) & 0xFF);

        fwrite(msg, 1, midx, stdout);
        fflush(stdout);

        seq++;
	}

	/* return to idle thread */
	return 0;
}
```

## src/imu.h
```c
#ifndef _IMU_H_
#define _IMU_H_

struct accel_data{
    double x;
    double y;
    double z;
};

struct gyro_data{
    double x;
    double y;
    double z;
};

typedef struct {
    struct accel_data accel;
    struct gyro_data gyro;
}IMU_Data;

typedef struct __attribute__((packed)){
    float x;
    float y;
    float z;
}Sensor_DataPacked;

typedef struct __attribute__((packed)) {
    Sensor_DataPacked accel;
    Sensor_DataPacked gyro;
} IMU_DataPacked;

#endif
```
